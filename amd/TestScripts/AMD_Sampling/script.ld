
/* Script for -z combreloc -z separate-code */
/* Copyright (C) 2014-2020 Free Software Foundation, Inc.
   Copying and distribution of this script, with or without modification,
   are permitted in any medium without royalty provided the copyright
   notice and this notice are preserved.  */
OUTPUT_FORMAT("elf64-x86-64", "elf64-x86-64",
	      "elf64-x86-64")
OUTPUT_ARCH(i386:x86-64)
ENTRY(_start)
SEARCH_DIR("=/usr/local/lib/x86_64-linux-gnu"); SEARCH_DIR("=/lib/x86_64-linux-gnu"); SEARCH_DIR("=/usr/lib/x86_64-linux-gnu"); SEARCH_DIR("=/usr/lib/x86_64-linux-gnu64"); SEARCH_DIR("=/usr/local/lib64"); SEARCH_DIR("=/lib64"); SEARCH_DIR("=/usr/lib64"); SEARCH_DIR("=/usr/local/lib"); SEARCH_DIR("=/lib"); SEARCH_DIR("=/usr/lib"); SEARCH_DIR("=/usr/x86_64-linux-gnu/lib64"); SEARCH_DIR("=/usr/x86_64-linux-gnu/lib");
SECTIONS
{
  PROVIDE (__executable_start = SEGMENT_START("text-segment", 0x400000)); . = SEGMENT_START("text-segment", 0x400000) + SIZEOF_HEADERS;
  .interp         : { *(.interp) }
  .note.gnu.build-id  : { *(.note.gnu.build-id) }
  .hash           : { *(.hash) }
  .gnu.hash       : { *(.gnu.hash) }
  .dynsym         : { *(.dynsym) }
  .dynstr         : { *(.dynstr) }
  .gnu.version    : { *(.gnu.version) }
  .gnu.version_d  : { *(.gnu.version_d) }
  .gnu.version_r  : { *(.gnu.version_r) }
  .rela.dyn       :
    {
      *(.rela.init)
      *(.rela.text .rela.text.* .rela.gnu.linkonce.t.*)
      *(.rela.fini)
      *(.rela.rodata .rela.rodata.* .rela.gnu.linkonce.r.*)
      *(.rela.data .rela.data.* .rela.gnu.linkonce.d.*)
      *(.rela.tdata .rela.tdata.* .rela.gnu.linkonce.td.*)
      *(.rela.tbss .rela.tbss.* .rela.gnu.linkonce.tb.*)
      *(.rela.ctors)
      *(.rela.dtors)
      *(.rela.got)
      *(.rela.bss .rela.bss.* .rela.gnu.linkonce.b.*)
      *(.rela.ldata .rela.ldata.* .rela.gnu.linkonce.l.*)
      *(.rela.lbss .rela.lbss.* .rela.gnu.linkonce.lb.*)
      *(.rela.lrodata .rela.lrodata.* .rela.gnu.linkonce.lr.*)
      *(.rela.ifunc)
    }
  .rela.plt       :
    {
      *(.rela.plt)
      PROVIDE_HIDDEN (__rela_iplt_start = .);
      *(.rela.iplt)
      PROVIDE_HIDDEN (__rela_iplt_end = .);
    }
  . = ALIGN(CONSTANT (MAXPAGESIZE));
  .init           :
  {
    KEEP (*(SORT_NONE(.init)))
  }
  .plt            : { *(.plt) *(.iplt) }
.plt.got        : { *(.plt.got) }
.plt.sec        : { *(.plt.sec) }
  . = 0x40000000;
  .text           :
  {
    b64.o (.text .stub .text.* .gnu.linkonce.t.*)
    *(.text.unlikely .text.*_unlikely .text.unlikely.*)
    *(.text.exit .text.exit.*)
    *(.text.startup .text.startup.*)
    *(.text.hot .text.hot.*)
    *(SORT(.text.sorted.*))
    a64.o (.text .stub .text.* .gnu.linkonce.t.*)
    /* .gnu.warning sections are handled specially by elf.em.  */
    *(.gnu.warning)
  }
  .fini           :
  {
    KEEP (*(SORT_NONE(.fini)))
  }
  PROVIDE (__etext = .);
  PROVIDE (_etext = .);
  PROVIDE (etext = .);
  . = ALIGN(CONSTANT (MAXPAGESIZE));
  /* Adjust the address for the rodata segment.  We want to adjust up to
     the same address within the page on the next page up.  */
  . = SEGMENT_START("rodata-segment", ALIGN(CONSTANT (MAXPAGESIZE)) + (. & (CONSTANT (MAXPAGESIZE) - 1)));
  .rodata         : { *(.rodata .rodata.* .gnu.linkonce.r.*) }
  .rodata1        : { *(.rodata1) }
  .eh_frame_hdr   : { *(.eh_frame_hdr) *(.eh_frame_entry .eh_frame_entry.*) }
  .eh_frame       : ONLY_IF_RO { KEEP (*(.eh_frame)) *(.eh_frame.*) }
  .gcc_except_table   : ONLY_IF_RO { *(.gcc_except_table .gcc_except_table.*) }
  .gnu_extab   : ONLY_IF_RO { *(.gnu_extab*) }
  /* These sections are generated by the Sun/Oracle C++ compiler.  */
  .exception_ranges   : ONLY_IF_RO { *(.exception_ranges*) }
  /* Adjust the address for the data segment.  We want to adjust up to
     the same address within the page on the next page up.  */
  . = DATA_SEGMENT_ALIGN (CONSTANT (MAXPAGESIZE), CONSTANT (COMMONPAGESIZE));
  /* Exception handling  */
  .eh_frame       : ONLY_IF_RW { KEEP (*(.eh_frame)) *(.eh_frame.*) }
  .gnu_extab      : ONLY_IF_RW { *(.gnu_extab) }
  .gcc_except_table   : ONLY_IF_RW { *(.gcc_except_table .gcc_except_table.*) }
  .exception_ranges   : ONLY_IF_RW { *(.exception_ranges*) }
  /* Thread Local Storage sections  */
  .tdata	  :
   {
     PROVIDE_HIDDEN (__tdata_start = .);
     *(.tdata .tdata.* .gnu.linkonce.td.*)
   }
  .tbss		  : { *(.tbss .tbss.* .gnu.linkonce.tb.*) *(.tcommon) }
  .preinit_array    :
  {
    PROVIDE_HIDDEN (__preinit_array_start = .);
    KEEP (*(.preinit_array))
    PROVIDE_HIDDEN (__preinit_array_end = .);
  }
  .init_array    :
  {
    PROVIDE_HIDDEN (__init_array_start = .);
    KEEP (*(SORT_BY_INIT_PRIORITY(.init_array.*) SORT_BY_INIT_PRIORITY(.ctors.*)))
    KEEP (*(.init_array EXCLUDE_FILE (*crtbegin.o *crtbegin?.o *crtend.o *crtend?.o ) .ctors))
    PROVIDE_HIDDEN (__init_array_end = .);
  }
  .fini_array    :
  {
    PROVIDE_HIDDEN (__fini_array_start = .);
    KEEP (*(SORT_BY_INIT_PRIORITY(.fini_array.*) SORT_BY_INIT_PRIORITY(.dtors.*)))
    KEEP (*(.fini_array EXCLUDE_FILE (*crtbegin.o *crtbegin?.o *crtend.o *crtend?.o ) .dtors))
    PROVIDE_HIDDEN (__fini_array_end = .);
  }
  .ctors          :
  {
    /* gcc uses crtbegin.o to find the start of
       the constructors, so we make sure it is
       first.  Because this is a wildcard, it
       doesn't matter if the user does not
       actually link against crtbegin.o; the
       linker won't look for a file to match a
       wildcard.  The wildcard also means that it
       doesn't matter which directory crtbegin.o
       is in.  */
    KEEP (*crtbegin.o(.ctors))
    KEEP (*crtbegin?.o(.ctors))
    /* We don't want to include the .ctor section from
       the crtend.o file until after the sorted ctors.
       The .ctor section from the crtend file contains the
       end of ctors marker and it must be last */
    KEEP (*(EXCLUDE_FILE (*crtend.o *crtend?.o ) .ctors))
    KEEP (*(SORT(.ctors.*)))
    KEEP (*(.ctors))
  }
  .dtors          :
  {
    KEEP (*crtbegin.o(.dtors))
    KEEP (*crtbegin?.o(.dtors))
    KEEP (*(EXCLUDE_FILE (*crtend.o *crtend?.o ) .dtors))
    KEEP (*(SORT(.dtors.*)))
    KEEP (*(.dtors))
  }
  .jcr            : { KEEP (*(.jcr)) }
  .data.rel.ro : { *(.data.rel.ro.local* .gnu.linkonce.d.rel.ro.local.*) *(.data.rel.ro .data.rel.ro.* .gnu.linkonce.d.rel.ro.*) }
  .dynamic        : { *(.dynamic) }
  .got            : { *(.got) *(.igot) }
  . = DATA_SEGMENT_RELRO_END (SIZEOF (.got.plt) >= 24 ? 24 : 0, .);
  .got.plt        : { *(.got.plt) *(.igot.plt) }
  .data           :
  {
    *(.data .data.* .gnu.linkonce.d.*)
    SORT(CONSTRUCTORS)
  }
  .data1          : { *(.data1) }
  _edata = .; PROVIDE (edata = .);
  . = .;
  __bss_start = .;
  .bss            :
  {
   *(.dynbss)
   *(.bss .bss.* .gnu.linkonce.b.*)
   *(COMMON)
   /* Align here to ensure that the .bss section occupies space up to
      _end.  Align after .bss to ensure correct alignment even if the
      .bss section disappears because there are no input sections.
      FIXME: Why do we need it? When there is no .bss section, we do not
      pad the .data section.  */
   . = ALIGN(. != 0 ? 64 / 8 : 1);
  }
  .lbss   :
  {
    *(.dynlbss)
    *(.lbss .lbss.* .gnu.linkonce.lb.*)
    *(LARGE_COMMON)
  }
  . = ALIGN(64 / 8);
  . = SEGMENT_START("ldata-segment", .);
  .lrodata   ALIGN(CONSTANT (MAXPAGESIZE)) + (. & (CONSTANT (MAXPAGESIZE) - 1)) :
  {
    *(.lrodata .lrodata.* .gnu.linkonce.lr.*)
  }
  .ldata   ALIGN(CONSTANT (MAXPAGESIZE)) + (. & (CONSTANT (MAXPAGESIZE) - 1)) :
  {
    *(.ldata .ldata.* .gnu.linkonce.l.*)
    . = ALIGN(. != 0 ? 64 / 8 : 1);
  }
  . = ALIGN(64 / 8);
  _end = .; PROVIDE (end = .);
  . = DATA_SEGMENT_END (.);
  /* Stabs debugging sections.  */
  .stab          0 : { *(.stab) }
  .stabstr       0 : { *(.stabstr) }
  .stab.excl     0 : { *(.stab.excl) }
  .stab.exclstr  0 : { *(.stab.exclstr) }
  .stab.index    0 : { *(.stab.index) }
  .stab.indexstr 0 : { *(.stab.indexstr) }
  .comment       0 : { *(.comment) }
  .gnu.build.attributes : { *(.gnu.build.attributes .gnu.build.attributes.*) }
  /* DWARF debug sections.
     Symbols in the DWARF debugging sections are relative to the beginning
     of the section so we begin them at 0.  */
  /* DWARF 1 */
  .debug          0 : { *(.debug) }
  .line           0 : { *(.line) }
  /* GNU DWARF 1 extensions */
  .debug_srcinfo  0 : { *(.debug_srcinfo) }
  .debug_sfnames  0 : { *(.debug_sfnames) }
  /* DWARF 1.1 and DWARF 2 */
  .debug_aranges  0 : { *(.debug_aranges) }
  .debug_pubnames 0 : { *(.debug_pubnames) }
  /* DWARF 2 */
  .debug_info     0 : { *(.debug_info .gnu.linkonce.wi.*) }
  .debug_abbrev   0 : { *(.debug_abbrev) }
  .debug_line     0 : { *(.debug_line .debug_line.* .debug_line_end) }
  .debug_frame    0 : { *(.debug_frame) }
  .debug_str      0 : { *(.debug_str) }
  .debug_loc      0 : { *(.debug_loc) }
  .debug_macinfo  0 : { *(.debug_macinfo) }
  /* SGI/MIPS DWARF 2 extensions */
  .debug_weaknames 0 : { *(.debug_weaknames) }
  .debug_funcnames 0 : { *(.debug_funcnames) }
  .debug_typenames 0 : { *(.debug_typenames) }
  .debug_varnames  0 : { *(.debug_varnames) }
  /* DWARF 3 */
  .debug_pubtypes 0 : { *(.debug_pubtypes) }
  .debug_ranges   0 : { *(.debug_ranges) }
  /* DWARF Extension.  */
  .debug_macro    0 : { *(.debug_macro) }
  .debug_addr     0 : { *(.debug_addr) }
  .gnu.attributes 0 : { KEEP (*(.gnu.attributes)) }
  /DISCARD/ : { *(.note.GNU-stack) *(.gnu_debuglink) *(.gnu.lto_*) }


  . = 0x100000000;
  .dummy_branch_0 : { *(.dummy_branch_0) }

  . = 0x110000000;
  .dummy_branch_1 : { *(.dummy_branch_1) }

  . = 0x120000000;
  .dummy_branch_2 : { *(.dummy_branch_2) }

  . = 0x130000000;
  .dummy_branch_3 : { *(.dummy_branch_3) }

  . = 0x140000000;
  .dummy_branch_4 : { *(.dummy_branch_4) }

  . = 0x150000000;
  .dummy_branch_5 : { *(.dummy_branch_5) }

  . = 0x160000000;
  .dummy_branch_6 : { *(.dummy_branch_6) }

  . = 0x170000000;
  .dummy_branch_7 : { *(.dummy_branch_7) }

  . = 0x180000000;
  .dummy_branch_8 : { *(.dummy_branch_8) }

  . = 0x190000000;
  .dummy_branch_9 : { *(.dummy_branch_9) }

  . = 0x1a0000000;
  .dummy_branch_10 : { *(.dummy_branch_10) }

  . = 0x1b0000000;
  .dummy_branch_11 : { *(.dummy_branch_11) }

  . = 0x1c0000000;
  .dummy_branch_12 : { *(.dummy_branch_12) }

  . = 0x1d0000000;
  .dummy_branch_13 : { *(.dummy_branch_13) }

  . = 0x1e0000000;
  .dummy_branch_14 : { *(.dummy_branch_14) }

  . = 0x1f0000000;
  .dummy_branch_15 : { *(.dummy_branch_15) }

  . = 0x200000000;
  .dummy_branch_16 : { *(.dummy_branch_16) }

  . = 0x210000000;
  .dummy_branch_17 : { *(.dummy_branch_17) }

  . = 0x220000000;
  .dummy_branch_18 : { *(.dummy_branch_18) }

  . = 0x230000000;
  .dummy_branch_19 : { *(.dummy_branch_19) }

  . = 0x240000000;
  .dummy_branch_20 : { *(.dummy_branch_20) }

  . = 0x250000000;
  .dummy_branch_21 : { *(.dummy_branch_21) }

  . = 0x260000000;
  .dummy_branch_22 : { *(.dummy_branch_22) }

  . = 0x270000000;
  .dummy_branch_23 : { *(.dummy_branch_23) }

  . = 0x280000000;
  .dummy_branch_24 : { *(.dummy_branch_24) }

  . = 0x290000000;
  .dummy_branch_25 : { *(.dummy_branch_25) }

  . = 0x2a0000000;
  .dummy_branch_26 : { *(.dummy_branch_26) }

  . = 0x2b0000000;
  .dummy_branch_27 : { *(.dummy_branch_27) }

  . = 0x2c0000000;
  .dummy_branch_28 : { *(.dummy_branch_28) }

  . = 0x2d0000000;
  .dummy_branch_29 : { *(.dummy_branch_29) }

  . = 0x2e0000000;
  .dummy_branch_30 : { *(.dummy_branch_30) }

  . = 0x2f0000000;
  .dummy_branch_31 : { *(.dummy_branch_31) }

  . = 0x300000000;
  .dummy_branch_32 : { *(.dummy_branch_32) }

  . = 0x310000000;
  .dummy_branch_33 : { *(.dummy_branch_33) }

  . = 0x320000000;
  .dummy_branch_34 : { *(.dummy_branch_34) }

  . = 0x330000000;
  .dummy_branch_35 : { *(.dummy_branch_35) }

  . = 0x340000000;
  .dummy_branch_36 : { *(.dummy_branch_36) }

  . = 0x350000000;
  .dummy_branch_37 : { *(.dummy_branch_37) }

  . = 0x360000000;
  .dummy_branch_38 : { *(.dummy_branch_38) }

  . = 0x370000000;
  .dummy_branch_39 : { *(.dummy_branch_39) }

  . = 0x380000000;
  .dummy_branch_40 : { *(.dummy_branch_40) }

  . = 0x390000000;
  .dummy_branch_41 : { *(.dummy_branch_41) }

  . = 0x3a0000000;
  .dummy_branch_42 : { *(.dummy_branch_42) }

  . = 0x3b0000000;
  .dummy_branch_43 : { *(.dummy_branch_43) }

  . = 0x3c0000000;
  .dummy_branch_44 : { *(.dummy_branch_44) }

  . = 0x3d0000000;
  .dummy_branch_45 : { *(.dummy_branch_45) }

  . = 0x3e0000000;
  .dummy_branch_46 : { *(.dummy_branch_46) }

  . = 0x3f0000000;
  .dummy_branch_47 : { *(.dummy_branch_47) }

  . = 0x400000000;
  .dummy_branch_48 : { *(.dummy_branch_48) }

  . = 0x410000000;
  .dummy_branch_49 : { *(.dummy_branch_49) }

  . = 0x420000000;
  .dummy_branch_50 : { *(.dummy_branch_50) }

  . = 0x430000000;
  .dummy_branch_51 : { *(.dummy_branch_51) }

  . = 0x440000000;
  .dummy_branch_52 : { *(.dummy_branch_52) }

  . = 0x450000000;
  .dummy_branch_53 : { *(.dummy_branch_53) }

  . = 0x460000000;
  .dummy_branch_54 : { *(.dummy_branch_54) }

  . = 0x470000000;
  .dummy_branch_55 : { *(.dummy_branch_55) }

  . = 0x480000000;
  .dummy_branch_56 : { *(.dummy_branch_56) }

  . = 0x490000000;
  .dummy_branch_57 : { *(.dummy_branch_57) }

  . = 0x4a0000000;
  .dummy_branch_58 : { *(.dummy_branch_58) }

  . = 0x4b0000000;
  .dummy_branch_59 : { *(.dummy_branch_59) }

  . = 0x4c0000000;
  .dummy_branch_60 : { *(.dummy_branch_60) }
}